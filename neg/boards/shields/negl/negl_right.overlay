#include "negl.dtsi"

&default_transform {
    col-offset = <8>;
};

&kscan0 {
    col-gpios
        = <&shifter 0 (GPIO_ACTIVE_HIGH | GPIO_PULL_DOWN)>
        , <&shifter 1 (GPIO_ACTIVE_HIGH | GPIO_PULL_DOWN)>
        , <&shifter 2 (GPIO_ACTIVE_HIGH | GPIO_PULL_DOWN)>
        , <&shifter 3 (GPIO_ACTIVE_HIGH | GPIO_PULL_DOWN)>
        , <&shifter 4 (GPIO_ACTIVE_HIGH | GPIO_PULL_DOWN)>
        , <&shifter 5 (GPIO_ACTIVE_HIGH | GPIO_PULL_DOWN)>
        , <&shifter 6 (GPIO_ACTIVE_HIGH | GPIO_PULL_DOWN)>
        , <&shifter 7 (GPIO_ACTIVE_HIGH | GPIO_PULL_DOWN)>
        ;
};
