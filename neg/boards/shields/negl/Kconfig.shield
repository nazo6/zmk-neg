## neg/boards/shields/negl/Kconfig.shield
```kconfig
config SHIELD_NEG_LEFT
    def_bool $(shields_list_contains,negl_left)

config SHIELD_NEG_RIGHT
    def_bool $(shields_list_contains,negl_right)
```
