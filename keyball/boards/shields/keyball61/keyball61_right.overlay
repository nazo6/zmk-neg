#include "keyball.dtsi"

&kscan0 {
    col-gpios
        = <&pro_micro 29 GPIO_ACTIVE_HIGH>
        , <&pro_micro 28 GPIO_ACTIVE_HIGH>
        , <&pro_micro 27 GPIO_ACTIVE_HIGH>
        , <&pro_micro 26 GPIO_ACTIVE_HIGH>
        ;
};
